## configs/raspi3-qt5we/raspberrypi3_qt5we_defconfig
```kconfig
BR2_arm=y
BR2_cortex_a53=y
BR2_ARM_FPU_NEON_VFPV4=y
BR2_DL_DIR="$(TOPDIR)/../dl"
BR2_TOOLCHAIN_BUILDROOT_GLIBC=y
BR2_PACKAGE_HOST_LINUX_HEADERS_CUSTOM_4_9=y
BR2_TOOLCHAIN_BUILDROOT_CXX=y
BR2_TARGET_GENERIC_ISSUE="Welcome to BrBox"
BR2_ROOTFS_DEVICE_CREATION_DYNAMIC_EUDEV=y
BR2_SYSTEM_DHCP="eth0"
BR2_ROOTFS_OVERLAY="$(TOPDIR)/../configs/raspi3-qt5we/disk_skeleton"
BR2_ROOTFS_POST_BUILD_SCRIPT="board/raspberrypi3/post-build.sh"
BR2_ROOTFS_POST_IMAGE_SCRIPT="board/raspberrypi3/post-image.sh"
BR2_ROOTFS_POST_SCRIPT_ARGS="--add-pi3-miniuart-bt-overlay --gpu_mem_1024=200"
BR2_LINUX_KERNEL=y
BR2_LINUX_KERNEL_CUSTOM_GIT=y
BR2_LINUX_KERNEL_CUSTOM_REPO_URL="https://github.com/raspberrypi/linux.git"
BR2_LINUX_KERNEL_CUSTOM_REPO_VERSION="33ee56d5927ceff630fbc87e3f5caa409b6ae114"
BR2_LINUX_KERNEL_DEFCONFIG="bcm2709"
BR2_LINUX_KERNEL_DTS_SUPPORT=y
BR2_LINUX_KERNEL_INTREE_DTS_NAME="bcm2710-rpi-3-b bcm2710-rpi-cm3"
BR2_LINUX_KERNEL_INSTALL_TARGET=y
BR2_PACKAGE_LIBERATION=y
BR2_PACKAGE_QT5=y
BR2_PACKAGE_QT5BASE_EXAMPLES=y
BR2_PACKAGE_QT5BASE_GIF=y
BR2_PACKAGE_QT5BASE_JPEG=y
BR2_PACKAGE_QT5BASE_PNG=y
BR2_PACKAGE_QT5WEBENGINE=y
BR2_PACKAGE_QT5WEBENGINE_PROPRIETARY_CODECS=y
BR2_PACKAGE_RPI_FIRMWARE=y
BR2_PACKAGE_RPI_USERLAND=y
BR2_PACKAGE_CA_CERTIFICATES=y
BR2_PACKAGE_NTP=y
BR2_TARGET_ROOTFS_EXT2=y
BR2_TARGET_ROOTFS_EXT2_4=y
BR2_TARGET_ROOTFS_EXT2_SIZE="360M"
BR2_TARGET_ROOTFS_TAR_XZ=y
BR2_PACKAGE_HOST_DOSFSTOOLS=y
BR2_PACKAGE_HOST_GENIMAGE=y
BR2_PACKAGE_HOST_MTOOLS=y
```

## configs/raspi3/raspberrypi3_defconfig
```kconfig
BR2_arm=y
BR2_cortex_a7=y
BR2_ARM_FPU_NEON_VFPV4=y
BR2_DL_DIR="$(TOPDIR)/../dl"
BR2_PACKAGE_HOST_LINUX_HEADERS_CUSTOM_4_4=y
BR2_TOOLCHAIN_BUILDROOT_GLIBC=y
BR2_GCC_VERSION_6_X=y
BR2_TOOLCHAIN_BUILDROOT_CXX=y
BR2_TARGET_GENERIC_ISSUE="Welcome to BrBox"
BR2_ROOTFS_DEVICE_CREATION_DYNAMIC_EUDEV=y
BR2_TARGET_GENERIC_GETTY_PORT="tty1"
BR2_SYSTEM_DHCP="eth0"
BR2_ROOTFS_OVERLAY="$(TOPDIR)/../disk_skeleton"
BR2_ROOTFS_POST_BUILD_SCRIPT="$(TOPDIR)/../scripts/brbox-raspi3-post-build.sh"
BR2_LINUX_KERNEL=y
BR2_LINUX_KERNEL_CUSTOM_GIT=y
BR2_LINUX_KERNEL_CUSTOM_REPO_URL="https://github.com/raspberrypi/linux.git"
BR2_LINUX_KERNEL_CUSTOM_REPO_VERSION="26f3b72a9c049be10e6af196252283e1f6ab9d1f"
BR2_LINUX_KERNEL_USE_CUSTOM_CONFIG=y
BR2_LINUX_KERNEL_CUSTOM_CONFIG_FILE="$(TOPDIR)/board/raspberrypi3/linux.config"
BR2_LINUX_KERNEL_DTS_SUPPORT=y
BR2_LINUX_KERNEL_INTREE_DTS_NAME="bcm2710-rpi-3-b"
BR2_LINUX_KERNEL_INSTALL_TARGET=y
BR2_PACKAGE_BUSYBOX_SHOW_OTHERS=y
BR2_PACKAGE_GSTREAMER1=y
BR2_PACKAGE_GST1_PLUGINS_BASE_PLUGIN_AUDIORATE=y
BR2_PACKAGE_GST1_PLUGINS_BASE_PLUGIN_AUDIOTESTSRC=y
BR2_PACKAGE_GST1_PLUGINS_BASE_PLUGIN_VIDEOCONVERT=y
BR2_PACKAGE_GST1_PLUGINS_BASE_PLUGIN_VIDEOTESTSRC=y
BR2_PACKAGE_GST1_PLUGINS_BASE_PLUGIN_VIDEORATE=y
BR2_PACKAGE_GST1_PLUGINS_BASE_PLUGIN_OGG=y
BR2_PACKAGE_GST1_PLUGINS_BASE_PLUGIN_OPUS=y
BR2_PACKAGE_GST1_PLUGINS_BASE_PLUGIN_THEORA=y
BR2_PACKAGE_GST1_PLUGINS_BASE_PLUGIN_VORBIS=y
BR2_PACKAGE_GST1_PLUGINS_GOOD=y
BR2_PACKAGE_GST1_PLUGINS_GOOD_PLUGIN_AUTODETECT=y
BR2_PACKAGE_GST1_PLUGINS_GOOD_PLUGIN_MATROSKA=y
BR2_PACKAGE_GST1_PLUGINS_GOOD_PLUGIN_RTP=y
BR2_PACKAGE_GST1_PLUGINS_GOOD_PLUGIN_RTPMANAGER=y
BR2_PACKAGE_GST1_PLUGINS_GOOD_PLUGIN_RTSP=y
BR2_PACKAGE_GST1_PLUGINS_GOOD_PLUGIN_UDP=y
BR2_PACKAGE_GST1_PLUGINS_GOOD_PLUGIN_VIDEOCROP=y
BR2_PACKAGE_GST1_PLUGINS_BAD=y
BR2_PACKAGE_GST1_PLUGINS_BAD_LIB_OPENGL=y
BR2_PACKAGE_GST1_PLUGINS_BAD_PLUGIN_AUTOCONVERT=y
BR2_PACKAGE_GST1_PLUGINS_BAD_PLUGIN_MPEGTSDEMUX=y
BR2_PACKAGE_GST1_PLUGINS_BAD_PLUGIN_SDP=y
BR2_PACKAGE_GST1_PLUGINS_BAD_PLUGIN_VIDEOPARSERS=y
BR2_PACKAGE_GST1_PLUGINS_BAD_PLUGIN_FAAD=y
BR2_PACKAGE_GST1_PLUGINS_BAD_PLUGIN_FBDEV=y
BR2_PACKAGE_GST1_PLUGINS_UGLY=y
BR2_PACKAGE_GST1_LIBAV=y
BR2_PACKAGE_GST_OMX=y
BR2_PACKAGE_OMXPLAYER=y
BR2_PACKAGE_BZIP2=y
BR2_PACKAGE_STRESS=y
BR2_PACKAGE_GREP=y
BR2_PACKAGE_E2FSPROGS=y
BR2_PACKAGE_MESA3D=y
BR2_PACKAGE_RPI_FIRMWARE=y
# BR2_PACKAGE_RPI_FIRMWARE_INSTALL_DTB_OVERLAYS is not set
BR2_PACKAGE_I2C_TOOLS=y
BR2_PACKAGE_LM_SENSORS=y
BR2_PACKAGE_RPI_USERLAND=y
BR2_PACKAGE_RPI_USERLAND_HELLO=y
BR2_PACKAGE_USB_MODESWITCH_DATA=y
BR2_PACKAGE_USBUTILS=y
BR2_PACKAGE_OPENSSL=y
BR2_PACKAGE_OPENSSL_BIN=y
BR2_PACKAGE_OPENSSL_ENGINES=y
BR2_PACKAGE_LIBCGICC=y
BR2_PACKAGE_LIBWEBSOCKETS=y
BR2_PACKAGE_DROPBEAR=y
BR2_PACKAGE_IFPLUGD=y
BR2_PACKAGE_IPERF=y
BR2_PACKAGE_LIGHTTPD=y
BR2_PACKAGE_LIGHTTPD_PCRE=y
BR2_PACKAGE_BASH=y
BR2_PACKAGE_FILE=y
BR2_PACKAGE_SCREEN=y
BR2_PACKAGE_COREUTILS=y
BR2_TARGET_BRBOX_PACKAGES=y
BR2_TARGET_BRBOX_COMMON=y
BR2_PACKAGE_HOST_BRBOX_MKIMAGE=y
BR2_PACKAGE_BRBOX_SYSMGR_INIT_ORDER="72"
BR2_PACKAGE_BRBOX_LIBONION=y
BR2_PACKAGE_BRBOX_RASPI2_UPDATE=y
BR2_PACKAGE_BRBOX_RASPI2_MOUNT=y
BR2_TARGET_ROOTFS_EXT2=y
BR2_TARGET_ROOTFS_EXT2_4=y
BR2_TARGET_ROOTFS_TAR_XZ=y
BR2_PACKAGE_HOST_DOSFSTOOLS=y
BR2_PACKAGE_HOST_GENIMAGE=y
BR2_PACKAGE_HOST_MTOOLS=y
```

## packages/Config.in
```kconfig
menu "BrBox Packages"

config BR2_TARGET_BRBOX_PACKAGES
        bool "BrBox Related packages"
	default n
        help
          Enable building of all BrBox related packages

config BR2_TARGET_BRBOX_SVNURL
        string "base svn location of BrBox Packages"
	default "http://github.com/hackboxguy/brbox/trunk"
        depends on BR2_TARGET_BRBOX_PACKAGES
        help
          From which svn location to checkout the sources during build process

config BR2_TARGET_BRBOX_COMMON
        bool "Common packages"
	depends on BR2_TARGET_BRBOX_PACKAGES
        help
          Enable building of common (non-board-specific) packages

if BR2_TARGET_BRBOX_COMMON
menu "Common packages"
source "package/brbox/brbox_libAdDisp/Config.in"
source "package/brbox/brbox_libAdSttngs/Config.in"
source "package/brbox/brbox_libAdCmnOld/Config.in"
source "package/brbox/brbox_libIlClient/Config.in"
source "package/brbox/brbox_mkimage/Config.in"
source "package/brbox/brbox_sysmgr/Config.in"
source "package/brbox/brbox_finddevtype/Config.in"
source "package/brbox/brbox_defhostname/Config.in"
source "package/brbox/brbox_huawei_e173udevrule/Config.in"
source "package/brbox/brbox_libgammu/Config.in"
source "package/brbox/brbox_libgloox/Config.in"
source "package/brbox/brbox_libonion/Config.in"
source "package/brbox/brbox_eeprog/Config.in"
source "package/brbox/brbox_x11startup/Config.in"
source "package/brbox/brbox_umtskeeper/Config.in"
source "package/brbox/brbox_lightyconfig/Config.in"
source "package/brbox/brbox_tftpdconfig/Config.in"
source "package/brbox/brbox_miscbins/Config.in"
source "package/brbox/brbox_samplemedia/Config.in"
source "package/brbox/brbox_zbarimg/Config.in"
source "package/brbox/brbox_fbtestapp/Config.in"
source "package/brbox/brbox_pngview/Config.in"
source "package/brbox/brbox_hellovideo/Config.in"
source "package/brbox/brbox_postbootup/Config.in"
source "package/brbox/brbox_preparebootdisk/Config.in"
source "package/brbox/brbox_gphoto2/Config.in"
endmenu
endif


source "package/brbox/brbox_baytrail_update/Config.in"
source "package/brbox/brbox_baytrail_mount/Config.in"
source "package/brbox/brbox_I210kmodAvbIgb/Config.in"
source "package/brbox/brbox_raspi2_update/Config.in"
source "package/brbox/brbox_raspi2_mount/Config.in"
source "package/brbox/brbox_bbb_update/Config.in"
source "package/brbox/brbox_bbbmmc_update/Config.in"
source "package/brbox/brbox_bbb_mount/Config.in"
source "package/brbox/brbox_bbbmmc_mount/Config.in"
source "package/brbox/brbox_gpiomgr/Config.in"
source "package/brbox/brbox_smarteye/Config.in"
source "package/brbox/brbox_bboxsms/Config.in"
source "package/brbox/brbox_xmproxy/Config.in"
source "package/brbox/brbox_apisrv/Config.in"
source "package/brbox/brbox_gstreamer_vaapi/Config.in"
source "package/brbox/brbox_genintrdrv/Config.in"
source "package/brbox/brbox_i2csrv/Config.in"
source "package/brbox/brbox_dispsrv/Config.in"
source "package/brbox/brbox_lightsense/Config.in"
source "package/brbox/brbox_mplaysrv/Config.in"
source "package/brbox/brbox_modbussrv/Config.in"
source "package/brbox/brbox_gstd/Config.in"
endmenu
```

## packages/brbox_I210kmodAvbIgb/Config.in
```kconfig
config BR2_PACKAGE_BRBOX_I210KMODAVBIGB
	bool "I210kmodAvbIgb"
	depends on BR2_LINUX_KERNEL
	default n
	help
	  Intel i210 igb driver with support for AVB

#comment "I210kmodAvbIgb needs a Linux kernel to be built"
#	depends on !BR2_LINUX_KERNEL
```

## packages/brbox_actkbd/Config.in
```kconfig
config BR2_PACKAGE_BRBOX_ACTKBD
	bool "brbox-actkbd"
	default n
	help
	  actkbd is a daemon for keyboard shortcuts.
	  https://github.com/thkala/actkbd
```

## packages/brbox_apisrv/Config.in
```kconfig
config BR2_PACKAGE_BRBOX_APISRV
	bool "Api-Service"
	default n
	select BR2_PACKAGE_BRBOX_LIBADCMNOLD
	select BR2_PACKAGE_BRBOX_LIBONION
	help
	  http-proxy gateway for rpc calls to api call

config BR2_PACKAGE_BRBOX_APISRV_INIT_ORDER
        string "apisrv init.d order"
        default "79"
        depends on BR2_PACKAGE_BRBOX_APISRV
        help
          At which place in the init.d startup this service should be started. Needs to be a 2-digit integer.
          Will be prefixed by "S" by buildroot, so e.g. "79" becomes "S79"
```

## packages/brbox_baytrail_mount/Config.in
```kconfig
config BR2_PACKAGE_BRBOX_BAYTRAIL_MOUNT
	bool "Settings partition mount startup-script for baytrail based target"
	default n
	depends on BR2_TARGET_BRBOX_PACKAGES
	help
	  provides mounting of settings partition on startup for baytrail based boards.
```

## packages/brbox_baytrail_update/Config.in
```kconfig
config BR2_PACKAGE_BRBOX_BAYTRAIL_UPDATE
	bool "Update Script for baytrail based target"
	default n
	depends on BR2_TARGET_BRBOX_PACKAGES
	help
	  provides in-system failsafe upgrade feature for baytrail based boards.
```

## packages/brbox_bbb_update/Config.in
```kconfig
config BR2_PACKAGE_BRBOX_BBB_UPDATE
	bool "Update Script for beagle-bone-black based target"
	default n
	depends on BR2_TARGET_BRBOX_PACKAGES
	help
	  provides in-system failsafe upgrade feature for beagle-bone-black based boards.
```

## packages/brbox_bbbmmc_mount/Config.in
```kconfig
config BR2_PACKAGE_BRBOX_BBBMMC_MOUNT
	bool "Settings partition mount startup-script for beagle-bone-black-mmc based target"
	default n
	depends on BR2_TARGET_BRBOX_PACKAGES
	help
	  provides mounting of settings partition on startup for beagle-bone-black-mmc based boards.
```

## packages/brbox_bbbmmc_update/Config.in
```kconfig
config BR2_PACKAGE_BRBOX_BBBMMC_UPDATE
	bool "Update Script for beagle-bone-black-mmc based target"
	default n
	depends on BR2_TARGET_BRBOX_PACKAGES
	help
	  provides in-system failsafe upgrade feature for beagle-bone-black-mmc based boards.
```

## packages/brbox_chandongle/Config.in
```kconfig
config BR2_PACKAGE_BRBOX_CHANDONGLE
	bool "asterisk-chan-dongle"
	default n
	depends on BR2_PACKAGE_ASTERISK
	help
	  chan-dongle module for adding gsm modem suppor to asterisk
```

## packages/brbox_defhostname/Config.in
```kconfig
config BR2_PACKAGE_BRBOX_DEFHOSTNAME
	bool "Default hostname startup-script for brbox platform"
	default y
	depends on BR2_TARGET_BRBOX_PACKAGES
	help
	  provides detection and creation of hostname on startup for brbox based boards.
```

## packages/brbox_dispsrv/Config.in
```kconfig
config BR2_PACKAGE_BRBOX_DISPSRV
	bool "Display-Control-Service"
	default n
	select BR2_PACKAGE_BRBOX_LIBADDISP
	select BR2_PACKAGE_BRBOX_LIBADCMNOLD
	help
		display control service for accessing oled display via rpc

config BR2_PACKAGE_BRBOX_DISPSRV_INIT_ORDER
        string "dispsrv init.d order"
        default "78"
        depends on BR2_PACKAGE_BRBOX_DISPSRV
        help
          At which place in the init.d startup this service should be started. Needs to be a 2-digit integer.
          Will be prefixed by "S" by buildroot, so e.g. "77" becomes "S77"
```
