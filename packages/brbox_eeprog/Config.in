## packages/brbox_eeprog/Config.in
```kconfig
config BR2_PACKAGE_BRBOX_EEPROG
	bool "eeprog i2c eeprom access tool"
	default y
	help
	  eeprog tool is used for accessing various i2c eeprom chips
```

## packages/brbox_fbtestapp/Config.in
```kconfig
config BR2_PACKAGE_BRBOX_FBTESTAPP
	bool "brbox-fb-test-app"
	help
	  Test suite for Linux framebuffer cloned from. 

	  https://github.com/prpplague/fb-test-app
```

## packages/brbox_fim/Config.in
```kconfig
config BR2_PACKAGE_BRBOX_FIM
	bool "fim - fbv improved image viewer"
	default n
	help
	  Dmidecode reports information about your system's hardware
	  as described in your system BIOS according to the SMBIOS/DMI
	  standard.

	  http://www.nongnu.org/dmidecode/
```

## packages/brbox_finddevtype/Config.in
```kconfig
config BR2_PACKAGE_BRBOX_FINDDEVTYPE
	bool "Find Device type startup-script for brbox platform"
	default y
	depends on BR2_TARGET_BRBOX_PACKAGES
	help
	  provides detection of board type on startup for brbox based boards.
```

## packages/brbox_flircutil/Config.in
```kconfig
config BR2_PACKAGE_BRBOX_FLIRCUTIL
	bool "brbox-flircutil"
	default n
	select BR2_PACKAGE_READLINE
	select BR2_PACKAGE_HIDAPI
	select BR2_PACKAGE_LIBUSB
	help
	  flirc_util is IR-USB HW dongle management tool.
	  https://github.com/hackboxguy/flirc-sdk
```

## packages/brbox_genintrdrv/Config.in
```kconfig
config BR2_PACKAGE_BRBOX_GENINTRDRV
        bool "generic-interrupt-driver"
        depends on BR2_LINUX_KERNEL
        help
          Kernel modules for generic interrupt driver.

comment "generic-interrupt-driver needs a Linux kernel to be built"
        depends on !BR2_LINUX_KERNEL

#config BR2_PACKAGE_BRBOX_GENINTRDRV_INIT_SCRIPT
#       string "auto insert module through init.d order"
#        default "S59GenIntrDrvStartup"
#        depends on BR2_PACKAGE_BRBOX_GENINTRDRV
#        help
#          Name of the startup script for loading the module
```

## packages/brbox_gphoto2/Config.in
```kconfig
config BR2_PACKAGE_BRBOX_GPHOTO2
	bool "gphoto2 commandline utility"
	default n
	help
	  includes gphoto2 commandline utility.
```

## packages/brbox_gpiomgr/Config.in
```kconfig
config BR2_PACKAGE_BRBOX_GPIOMGR
	bool "Gpio-Manager-Service"
	default n
	select BR2_PACKAGE_BRBOX_LIBADCMNOLD
	help
	  gpio manager service for supporting gpio control features via rpc

config BR2_PACKAGE_BRBOX_GPIOMGR_INIT_ORDER
        string "gpiomgr init.d order"
        default "71"
        depends on BR2_PACKAGE_BRBOX_GPIOMGR
        help
          At which place in the init.d startup this service should be started. Needs to be a 2-digit integer.
          Will be prefixed by "S" by buildroot, so e.g. "77" becomes "S77"
```

## packages/brbox_gstd/Config.in
```kconfig
config BR2_PACKAGE_BRBOX_GSTD
	bool "gstd"
	select BR2_PACKAGE_GSTREAMER1_CHECK
	select BR2_PACKAGE_GST1_PLUGINS_BASE
	select BR2_PACKAGE_READLINE
	select BR2_PACKAGE_NCURSES
	select BR2_PACKAGE_JSON_GLIB
	help
	  GStreamer Daemon is a GStreamer framework for controlling
	  audio and video streaming using TCP messages.
	  This version is based on GStreamer 1.x 

	  https://github.com/RidgeRun/gstd-1.x
```

## packages/brbox_gstdstartup/Config.in
```kconfig
config BR2_PACKAGE_BRBOX_GSTDSTARTUP
	bool "gstd daemon startup script and dependencies for brbox platform"
	default n
	depends on BR2_TARGET_BRBOX_PACKAGES
	select BR2_PACKAGE_BRBOX_GSTD
	help
	  provides mechanism to auto start gstd-daemon on linux bootup.
```

## packages/brbox_gstreamer_vaapi/Config.in
```kconfig
config BR2_PACKAGE_BRBOX_GSTREAMER_VAAPI
	bool "gstreamer-vaapi"
	depends on BR2_PACKAGE_GSTREAMER1
    depends on BR2_PACKAGE_LIBVA
	help
	  gstreamer-vaapi consists in a collection of VA-API based plugins for
	  GStreamer and helper libraries.
```

## packages/brbox_hellovideo/Config.in
```kconfig
config BR2_PACKAGE_BRBOX_HELLOVIDEO
	bool "hello-video media player for raspberry pi"
	default n
	select BR2_PACKAGE_BRBOX_LIBILCLIENT
	help
	  video player utility user h/w based decoding on raspberry pi
```

## packages/brbox_huawei_e173udevrule/Config.in
```kconfig
config BR2_PACKAGE_BRBOX_HUAWEI_E173UDEVRULE
	bool "On startup, automatically switch the E173 usb device as GSM modem"
	default n
	depends on BR2_TARGET_BRBOX_PACKAGES
	help
	  provides udev rule to switch E173 as GSM modem on startup.
```

## packages/brbox_i2csrv/Config.in
```kconfig
config BR2_PACKAGE_BRBOX_I2CSRV
	bool "I2C-Control-Service"
	default n
	select BR2_PACKAGE_BRBOX_LIBADCMNOLD
	help
		i2c bus service for supporting i2c control features via rpc

config BR2_PACKAGE_BRBOX_I2CSRV_INIT_ORDER
        string "i2csrv init.d order"
        default "69"
        depends on BR2_PACKAGE_BRBOX_I2CSRV
        help
          At which place in the init.d startup this service should be started. Needs to be a 2-digit integer.
          Will be prefixed by "S" by buildroot, so e.g. "77" becomes "S77"
```

## packages/brbox_libAdCmn/Config.in
```kconfig
config BR2_PACKAGE_BRBOX_LIBADCMN
	bool "libAdCommon"
	default n
	help
	  ADAV Common library for writing various services
```

## packages/brbox_libAdCmnOld/Config.in
```kconfig
config BR2_PACKAGE_BRBOX_LIBADCMNOLD
	bool "libAdCommonOld"
	default y
	select BR2_PACKAGE_JSON_C 
	select BR2_PACKAGE_BRBOX_LIBADSTTNGS
	depends on BR2_TOOLCHAIN_HAS_THREADS
	help
	  This shared object provide all services with gerneric thread/proxy/json interface .

comment "libAdCommonOld needs a toolchain with thread support"
	depends on !(BR2_TOOLCHAIN_HAS_THREADS)
```

## packages/brbox_libAdDisp/Config.in
```kconfig
config BR2_PACKAGE_BRBOX_LIBADDISP
	bool "libAdDisp"
	default y
	help
	  library for controlling i2c/spi based oled displays
```

## packages/brbox_libAdSttngs/Config.in
```kconfig
config BR2_PACKAGE_BRBOX_LIBADSTTNGS
	bool "libAdSettings"
	default y
	help
	  settings library to be used along with lib-adav for writing services
```

## packages/brbox_libIlClient/Config.in
```kconfig
config BR2_PACKAGE_BRBOX_LIBILCLIENT
	bool "libIlClient"
	default n
	help
	  ilclient library used by raspberry pi hello_video omx based video player
```

## packages/brbox_libgammu/Config.in
```kconfig
config BR2_PACKAGE_BRBOX_LIBGAMMU
	bool "libgammu"
	default n
	help
	  gammu library for gsm modems
```

## packages/brbox_libgloox/Config.in
```kconfig
config BR2_PACKAGE_BRBOX_LIBGLOOX
	bool "libgloox"
	default n
	help
	  portable c++ xmpp library
```

## packages/brbox_libonion/Config.in
```kconfig
config BR2_PACKAGE_BRBOX_LIBONION
	bool "libonion"
	default n
	help
	  c based http server library
```

## packages/brbox_lightsense/Config.in
```kconfig
config BR2_PACKAGE_BRBOX_LIGHTSENSE
	bool "Light-Sensor-Service"
	default n
	select BR2_PACKAGE_BRBOX_LIBADCMNOLD
	help
		light sensor service for accessing various color/brightness sensors

config BR2_PACKAGE_BRBOX_LIGHTSENSE_INIT_ORDER
        string "lightsensesrv init.d order"
        default "79"
        depends on BR2_PACKAGE_BRBOX_LIGHTSENSE
        help
          At which place in the init.d startup this service should be started. Needs to be a 2-digit integer.
          Will be prefixed by "S" by buildroot, so e.g. "79" becomes "S79"
```

## packages/brbox_lightyconfig/Config.in
```kconfig
config BR2_PACKAGE_BRBOX_LIGHTYCONFIG
	bool "overwrites default lighttpd configs"
	default n
	depends on BR2_TARGET_BRBOX_PACKAGES && BR2_PACKAGE_LIGHTTPD
	help
	  overwrites default lighttpd configs with brbox customized config.
```

## packages/brbox_miscbins/Config.in
```kconfig
config BR2_PACKAGE_BRBOX_MISCBINS
	bool "misc binary images(pattern files etc)"
	default n
	depends on BR2_TARGET_BRBOX_PACKAGES
	help
	  includes misc binaries to target file system.
```
