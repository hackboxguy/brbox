## packages/brbox_mkimage/Config.in
```kconfig
config BR2_PACKAGE_BRBOX_MKIMAGE
	bool "Modified u-boot mkimage tool"
	default y
	help
	  mkimage tool modified to support BRBOX image types plus some extra features

config BR2_PACKAGE_HOST_BRBOX_MKIMAGE
	bool "Modified u-boot mkimage tool (for host)"
	default n
	depends on BR2_PACKAGE_BRBOX_MKIMAGE
	help
		Also build host tool brbox-mkimage
```

## packages/brbox_modbussrv/Config.in
```kconfig
config BR2_PACKAGE_BRBOX_MODBUSSRV
	bool "Modbus-Control-Service"
	default n
	select BR2_PACKAGE_BRBOX_LIBADCMNOLD
	help
		modbus service for supporting modbus control features via rpc

config BR2_PACKAGE_BRBOX_MODBUSSRV_INIT_ORDER
        string "modbussrv init.d order"
        default "81"
        depends on BR2_PACKAGE_BRBOX_MODBUSSRV
        help
          At which place in the init.d startup this service should be started. Needs to be a 2-digit integer.
          Will be prefixed by "S" by buildroot, so e.g. "77" becomes "S77"
```

## packages/brbox_mplaysrv/Config.in
```kconfig
config BR2_PACKAGE_BRBOX_MPLAYSRV
	bool "Media-Player-Service"
	default n
	select BR2_PACKAGE_BRBOX_LIBADCMNOLD
	help
	  mplayer service for playing multi-media content

config BR2_PACKAGE_BRBOX_MPLAYSRV_INIT_ORDER
        string "mplaysrv init.d order"
        default "75"
        depends on BR2_PACKAGE_BRBOX_MPLAYSRV
        help
          At which place in the init.d startup this service should be started. Needs to be a 2-digit integer.
          Will be prefixed by "S" by buildroot, so e.g. "75" becomes "S75"
```

## packages/brbox_nrtp/Config.in
```kconfig
config BR2_PACKAGE_BRBOX_NRTP
	bool "nrtp"
	select BR2_PACKAGE_GSTREAMER1_CHECK
	select BR2_PACKAGE_GST1_PLUGINS_BASE
	select BR2_PACKAGE_GST1_PLUGINS_BASE_PLUGIN_APP
	help
	  nrtp is a new rtp srource/sink gst-plugins from Marc Leeman for easy usability of
	  audio and video streaming in gstreamer pipelines.
	  This version is based on GStreamer 1.x 

	  https://github.com/mleeman/gst-plugins-rtp
```

## packages/brbox_pngview/Config.in
```kconfig
config BR2_PACKAGE_BRBOX_PNGVIEW
	bool "brbox-pngview-app"
	help
	  png file rendering tool cloned from.
	  https://github.com/AndrewFromMelbourne/raspidmx/tree/master/pngview
```

## packages/brbox_postbootup/Config.in
```kconfig
config BR2_PACKAGE_BRBOX_POSTBOOTUP
	bool "linux post-bootup-late-init-script"
	default n
	depends on BR2_TARGET_BRBOX_PACKAGES
	help
	  includes a late-init script which is used for running custom actions at the last stage of linuxboot.
```

## packages/brbox_preparebootdisk/Config.in
```kconfig
config BR2_PACKAGE_BRBOX_PREPAREBOOTDISK
	bool "installs an automated boot disk creation script"
	default n
	depends on BR2_TARGET_BRBOX_PACKAGES
	help
	  installs automated boot disk creator script to the target script.
```

## packages/brbox_raspi2_mount/Config.in
```kconfig
config BR2_PACKAGE_BRBOX_RASPI2_MOUNT
	bool "Settings partition mount startup-script for raspi2 based target"
	default n
	depends on BR2_TARGET_BRBOX_PACKAGES
	help
	  provides mounting of settings partition on startup for raspi2 based boards.
```

## packages/brbox_raspi2_update/Config.in
```kconfig
config BR2_PACKAGE_BRBOX_RASPI2_UPDATE
	bool "Update Script for raspi2 based target"
	default n
	depends on BR2_TARGET_BRBOX_PACKAGES
	help
	  provides in-system failsafe upgrade feature for raspi2 based boards.
```

## packages/brbox_samplemedia/Config.in
```kconfig
config BR2_PACKAGE_BRBOX_SAMPLEMEDIA
	bool "sample media files"
	default n
	depends on BR2_TARGET_BRBOX_PACKAGES
	help
	  includes sample media files to target file system.
```

## packages/brbox_smarteye/Config.in
```kconfig
config BR2_PACKAGE_BRBOX_SMARTEYE
	bool "Smart-Eye-Service"
	default n
	select BR2_PACKAGE_BRBOX_LIBADCMNOLD
	help
	  smarteye service for machine processed imaging

config BR2_PACKAGE_BRBOX_SMARTEYE_INIT_ORDER
        string "smarteye init.d order"
        default "72"
        depends on BR2_PACKAGE_BRBOX_SMARTEYE
        help
          At which place in the init.d startup this service should be started. Needs to be a 2-digit integer.
          Will be prefixed by "S" by buildroot, so e.g. "77" becomes "S77"
```

## packages/brbox_sysmgr/Config.in
```kconfig
config BR2_PACKAGE_BRBOX_SYSMGR
	bool "System-Manager-Service"
	default y
	select BR2_PACKAGE_BRBOX_LIBADCMNOLD
	help
	  system manager service for supporting various system features via rpc

config BR2_PACKAGE_BRBOX_SYSMGR_INIT_ORDER
        string "smarteye init.d order"
        default "70"
        depends on BR2_PACKAGE_BRBOX_SYSMGR
        help
          At which place in the init.d startup this service should be started. Needs to be a 2-digit integer.
          Will be prefixed by "S" by buildroot, so e.g. "77" becomes "S77"
```

## packages/brbox_tftpdconfig/Config.in
```kconfig
config BR2_PACKAGE_BRBOX_TFTPDCONFIG
	bool "overwrites default tftpd config"
	default n
	depends on BR2_TARGET_BRBOX_PACKAGES && BR2_PACKAGE_TFTPD
	help
	  overwrites default tftpd config with brbox customized config.
```

## packages/brbox_umtskeeper/Config.in
```kconfig
config BR2_PACKAGE_BRBOX_UMTSKEEPER
	bool "3g data connectivity script"
	default n
	depends on BR2_TARGET_BRBOX_PACKAGES
	help
	  provides 3g data connectivity and monitoring to keep the connection alive.
```

## packages/brbox_x11startup/Config.in
```kconfig
config BR2_PACKAGE_BRBOX_X11STARTUP
	bool "X11 display server startup script and dependencies for brbox platform"
	default n
	depends on BR2_TARGET_BRBOX_PACKAGES
	help
	  provides mechanism to auto start X display server on linux bootup.
```

## packages/brbox_xmproxy/Config.in
```kconfig
config BR2_PACKAGE_BRBOX_XMPROXY
	bool "Xmproxy-Service"
	default n
	select BR2_PACKAGE_BRBOX_LIBADCMNOLD
	select BR2_PACKAGE_BRBOX_LIBGLOOX
	help
	  xmpp client agent for remote connectivity of devices behind firewall

config BR2_PACKAGE_BRBOX_XMPROXY_INIT_ORDER
        string "xmproxy init.d order"
        default "74"
        depends on BR2_PACKAGE_BRBOX_XMPROXY
        help
          At which place in the init.d startup this service should be started. Needs to be a 2-digit integer.
          Will be prefixed by "S" by buildroot, so e.g. "77" becomes "S77"
```

## packages/brbox_zbarimg/Config.in
```kconfig
config BR2_PACKAGE_BRBOX_ZBARIMG
	bool "prebuilt raspi1-zbarimg binary"
	default n
	help
	  includes prebuilt raspi1-zbarimg binary to targetfs.
```

## packages/gstreamer-vaapi/Config.in
```kconfig
config BR2_PACKAGE_GSTREAMER_VAAPI
	bool "gstreamer-vaapi"
	depends on BR2_PACKAGE_GSTREAMER
    depends on BR2_PACKAGE_LIBVA
	help
	  gstreamer-vaapi consists in a collection of VA-API based plugins for
	  GStreamer and helper libraries.
```
